/{
    chosen {
        zmk,kscan = &kscan0;
    };

    kscan0: kscan_0 {
        compatible = "zmk,kscan-gpio-direct";
        label = "KSCAN";

        input-gpios = <&gpio0 26 (GPIO_ACTIVE_HIGH | GPIO_PULL_DOWN)>,
                      <&gpio0 22 (GPIO_ACTIVE_HIGH | GPIO_PULL_DOWN)>,
                      <&gpio0 24 (GPIO_ACTIVE_HIGH | GPIO_PULL_DOWN)>,
                      <&gpio0 25 (GPIO_ACTIVE_HIGH | GPIO_PULL_DOWN)>,
                      <&gpio0 21 (GPIO_ACTIVE_HIGH | GPIO_PULL_DOWN)>;
    };
};
