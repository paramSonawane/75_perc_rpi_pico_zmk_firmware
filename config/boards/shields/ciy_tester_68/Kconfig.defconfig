## config/boards/shields/ciy_tester_68/Kconfig.defconfig
```kconfig
if SHIELD_CIY_TESTER_68

config ZMK_KEYBOARD_NAME
    default "CIY TESTER 68"

endif
```

## config/boards/shields/ciy_tester_68/Kconfig.shield
```kconfig
config SHIELD_TUBETEST
    def_bool $(shields_list_contains, SHIELD_CIY_TESTER_68)
```
